## west.yml
```yaml
manifest: 
  defaults:
    revision: main
    remote: git_zephyr
  
  group-filter: [+zephyr, +app, +hal, +tools, +fs, +crypto, +debug]

  remotes: 
    - name: gerrit_zephyr
      url-base: ssh://gerrit.pfa.fr.corp:29418/os/zephyr
    - name: git_zephyr
      url-base: https://github.com/zephyrproject-rtos/
  
  projects: 
    - name: zephyr
      revision: zephyr_3.5.0
      remote: gerrit_zephyr
      import: true 
      submodules: true
      groups:
        - zephyr
    
    - name: lips
      path: zephyr/zephyrproject/app
      remote: gerrit_zephyr
      revision: master
      groups: 
        - app
        
    - name: acpica
      revision: 0333c2af13179f9b33d495cf7cb9a509f751cbb1
      path: zephyr/zephyrproject/modules/lib/acpica

    - name: canopennode
      revision: dec12fa3f0d790cafa8414a4c2930ea71ab72ffd
      path: zephyr/zephyrproject/modules/lib/canopennode
      
    - name: cmsis
      revision: 5a00331455dd74e31e80efa383a489faea0590e3
      path: zephyr/zephyrproject/modules/hal/cmsis
      groups:
        - hal
        
    - name: cmsis-dsp
      revision: ff7b5fd1ea5f094665c090c343ec44e74dc0b193
      path: zephyr/zephyrproject/modules/lib/cmsis-dsp
      
    - name: cmsis-nn
      revision: 0c8669d81381ccf3b1a01d699f3b68b50134a99f
      path: zephyr/zephyrproject/modules/lib/cmsis-nn
      
    - name: edtt
      revision: 64e5105ad82390164fb73fc654be3f73a608209a
      path: zephyr/zephyrproject/tools/edtt
      groups:
        - tools
  
    - name: fatfs
      revision: 427159bf95ea49b7680facffaa29ad506b42709b
      path: zephyr/zephyrproject/modules/fs/fatfs
      groups:
        - fs
        
    - name: hal_altera
      revision: 0d225ddd314379b32355a00fb669eacf911e750d
      path: zephyr/zephyrproject/modules/hal/altera
      groups:
        - hal
  
    - name: hal_ambiq
      revision: 0a7c99325aa73a1ef777501da91c2c6608661e56
      path: zephyr/zephyrproject/modules/hal/ambiq
      groups:
        - hal

    - name: hal_atmel
      revision: 5ab43007eda3f380c125f957f03638d2e8d1144d
      path: zephyr/zephyrproject/modules/hal/atmel
      groups:
        - hal
      
    - name: hal_espressif
      revision: 31fc5758f3507f8f0af00b1dea1a0df7af99bfc0
      path: zephyr/zephyrproject/modules/hal/espressif
      groups:
        - hal
        
    - name: hal_ethos_u
      revision: 90ada2ea5681b2a2722a10d2898eac34c2510791
      path: zephyr/zephyrproject/modules/hal/ethos_u
      groups:
        - hal
        
    - name: hal_gigadevice
      revision: 2994b7dde8b0b0fa9b9c0ccb13474b6a486cddc3
      path: zephyr/zephyrproject/modules/hal/gigadevice
      groups:
        - hal
        
    - name: hal_infineon
      revision: 815e84a5150f95627201f192779a0180d5052de7
      path: zephyr/zephyrproject/modules/hal/infineon
      groups:
        - hal
        
    - name: hal_intel
      revision: b3b43d4e3da7ba483611bbbea7ef8af92c69df31
      path: zephyr/zephyrproject/modules/hal/intel
      groups:
        - hal
        
    - name: hal_microchip
      revision: 5d079f1683a00b801373bbbbf5d181d4e33b30d5
      path: zephyr/zephyrproject/modules/hal/microchip
      groups:
        - hal
        
    - name: hal_nordic
      revision: d054a315eb888ba70e09e5f6decd4097b0276d1f
      path: zephyr/zephyrproject/modules/hal/nordic
      groups:
        - hal
        
    - name: hal_nuvoton
      revision: 3e0a4c4d3328b2f72b164219add19d5308b53cb5
      path: zephyr/zephyrproject/modules/hal/nuvoton
      groups:
        - hal
    - name: hal_nxp
      revision: ad142f5612d927e29b1f9606e8edade871b8a526
      path: zephyr/zephyrproject/modules/hal/nxp
      groups:
        - hal
    - name: hal_openisa
      revision: d1e61c0c654d8ca9e73d27fca3a7eb3b7881cb6a
      path: zephyr/zephyrproject/modules/hal/openisa
      groups:
        - hal
    - name: hal_quicklogic
      revision: b3a66fe6d04d87fd1533a5c8de51d0599fcd08d0
      path: zephyr/zephyrproject/modules/hal/quicklogic
      repo-path: hal_quicklogic
      groups:
        - hal
        
    - name: hal_renesas
      path: zephyr/zephyrproject/modules/hal/renesas
      revision: a6cf2af9140e014fbbc48d2b6deb802231dd369f
      groups:
        - hal
      
    - name: hal_rpi_pico
      path: zephyr/zephyrproject/modules/hal/rpi_pico
      revision: fba7162cc7bee06d0149622bbcaac4e41062d368
      groups:
        - hal
    - name: hal_silabs
      revision: d191d981c4eb20c0c7445a4061fcdbcfa686113a
      path: zephyr/zephyrproject/modules/hal/silabs
      groups:
        - hal
    - name: hal_st
      revision: fb8e79d1a261fd02aadff7c142729f1954163cf3
      path: zephyr/zephyrproject/modules/hal/st
      groups:
        - hal
    - name: hal_stm32
      revision: 89ef0a3383edebf661073073bcdf6e2836fe90ee
      path: zephyr/zephyrproject/modules/hal/stm32
      groups:
        - hal
    - name: hal_telink
      revision: 38573af589173259801ae6c2b34b7d4c9e626746
      path: zephyr/zephyrproject/modules/hal/telink
      groups:
        - hal
    - name: hal_ti
      revision: b85f86e51fc4d47c4c383d320d64d52d4d371ae4
      path: zephyr/zephyrproject/modules/hal/ti
      groups:
        - hal
    - name: hal_wurthelektronik
      revision: 24ca9873c3d608fad1fea0431836bc8f144c132e
      path: zephyr/zephyrproject/modules/hal/wurthelektronik
      groups:
        - hal
    - name: hal_xtensa
      revision: e6da34fc07dfe96161ab8743f5dbeb6e6307ab93
      path: zephyr/zephyrproject/modules/hal/xtensa
      groups:
        - hal
    - name: libmetal
      revision: b91611a6f47dd29fb24c46e5621e797557f80ec6
      path: zephyr/zephyrproject/modules/hal/libmetal
      groups:
        - hal
    - name: liblc3
      revision: 448f3de31f49a838988a162ef1e23a89ddf2d2ed
      path: zephyr/zephyrproject/modules/lib/liblc3
    - name: littlefs
      path: zephyr/zephyrproject/modules/fs/littlefs
      groups:
        - fs
      revision: ca583fd297ceb48bced3c2548600dc615d67af24
    - name: loramac-node
      revision: 842413c5fb98707eb5f26e619e8e792453877897
      path: zephyr/zephyrproject/modules/lib/loramac-node
    - name: lvgl
      revision: 8a6a2d1d29d17d1e4bdc94c243c146a39d635fdd
      path: zephyr/zephyrproject/modules/lib/gui/lvgl
    - name: mbedtls
      revision: c38dc78d9a8dcbe43b898cc1171ab33ba3e6fc26
      path: zephyr/zephyrproject/modules/crypto/mbedtls
      groups:
        - crypto
    - name: mcuboot
      revision: 13767d0b72eb14ce42eb8aad1e5a133ef66afc54
      path: zephyr/zephyrproject/bootloader/mcuboot
    - name: mipi-sys-t
      path: zephyr/zephyrproject/modules/debug/mipi-sys-t
      groups:
        - debug
      revision: a819419603a2dfcb47f7f39092e1bc112e45d1ef
    - name: net-tools
      revision: d68ee9d17648a1bb3729c2023abfcb735dfe92fa
      path: zephyr/zephyrproject/tools/net-tools
      groups:
        - tools
    - name: nrf_hw_models
      revision: f4595802d32d103718bf50b3d390b7a450895843
      path: zephyr/zephyrproject/modules/bsim_hw_models/nrf_hw_models
    - name: open-amp
      revision: 42b7c577714b8f22ce82a901e19c1814af4609a8
      path: zephyr/zephyrproject/modules/lib/open-amp
    - name: openthread
      revision: d62167ee34b091e7025c9ec2820aae71e17a3944
      path: zephyr/zephyrproject/modules/lib/openthread
    - name: percepio
      path: zephyr/zephyrproject/modules/debug/percepio
      revision: a3728efccc47dd372f40e6313589ca4c5cc7d5e9
      groups:
        - debug
    - name: picolibc
      path: zephyr/zephyrproject/modules/lib/picolibc
      revision: d07c38ff051386f8e09a143ea0a6c1d6d66dd1d8
    - name: segger
      revision: 9d0191285956cef43daf411edc2f1a7788346def
      path: zephyr/zephyrproject/modules/debug/segger
      groups:
        - debug
    - name: tinycrypt
      revision: 3e9a49d2672ec01435ffbf0d788db6d95ef28de0
      path: zephyr/zephyrproject/modules/crypto/tinycrypt
      groups:
        - crypto
    - name: trusted-firmware-m
      revision: b168d92c7ed3c77c94d7ce3362bdde5dbffe8424
      path: zephyr/zephyrproject/modules/tee/tf-m/trusted-firmware-m
      groups:
        - tee
    - name: trusted-firmware-a
      revision: 421dc050278287839f5c70019bd6aec617f2bbdb
      path: zephyr/zephyrproject/modules/tee/tf-a/trusted-firmware-a
      groups:
        - tee
    - name: uoscore-uedhoc
      revision: 5fe2cb613bd7e4590bd1b00c2adf181ac0229379
      path: zephyr/zephyrproject/modules/lib/uoscore-uedhoc
    - name: zcbor
      revision: 67fd8bb88d3136738661fa8bb5f9989103f4599e
      path: zephyr/zephyrproject/modules/lib/zcbor
        

  
  self:
    path: manifest
```
